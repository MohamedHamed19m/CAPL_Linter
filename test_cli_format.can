/*@!Encoding:65001*/

variables{
    int x=1;

    string name="test";

    bool flag=true;

    float pi=3.14;

    struct Point{
        int x;int y;
    }

    int a=1, b=2, c=3;

    int[2][2][2]multi_dim=[[[1, 2], [3, 4]], [[5, 6], [7, 8]]];
}

void f(){
    enum Color{
      RED, GREEN, BLUE
    }

  if (x){
    return;
  }else {
    x=2;
  }
}

void g( ){
  for (int i=0;i < 10; i++){
    x=x + 1;
  }
}

void h(int a, int b, int c){
  while (a < b){
    a=a + 1;

    if (a == 5){
      break;
    }
  }
}

void complex(){
  if (x > 0){
    if (name == "test"){
      for (int j=0;j < 5; j++){
        if (j % 2 == 0){
          continue;
        }else{
          x=x - 1;
        }
      }
    }
  }else{
    return;
  }
}

void switch_test(Color c){
  switch (c){
    case RED:
    x=1;

    break;

    case GREEN:
    x=2;

    break;

    default:
    x=3;
  }
}

void inline_function(){
  a=b + c;

  return;
}

void long_line(){
  int very_long_variable_name=1;

  int another_long_name=2;

  int result=very_long_variable_name + another_long_name;
}

void mixed_spacing( int x , int y ){
  return x + y ;
}

void array_ops(){
  for (int i=0;i < arr.length; i++){
    arr[i]=arr[i] * 2;
  }
}

void empty(){
}

void another_empty( ){
}

void comments_test(){
  /*comment*/

  x=1;

  //inline

  //another comment

  y=2;
}

void operators(){
  x=1 + 2 * 3 / 4 - 5 % 2;

  bool result=(x > 5) && (x < 10) || (x == 7);
}

