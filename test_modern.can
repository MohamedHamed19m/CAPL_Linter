variables {
  int x;
  message 0x100 msg;
}

void MainFunction() {
  if (x == 1)   {
    write("Hello");
  }
}
