/*@!Encoding:65001*/
/***************************************
* File Desc *
****************************************
*! \file test_corner_cases2.can
* \brief Test corner cases for the CAN formatter, it includes "stdio.can"
* and "libs/math.cin", sets up library linking based on architecture,
* and defines variables including an enum, constants, and a struct array.
* It tests handling of different include styles and variable declarations and use initialize.py scripts.
* we also include "../libs/dll_file_64.dll"
*
* \author [ Mohamed ]
* \date June 2024
***************************************/
includes {
  #include "libs/math.cin"

  #include "../relative/path/to/lib.can"
  #include "stdio.can"

  #if x64
  #pragma library "../libs/dll_file_64.dll"
  #else
  #pragma library "../libs/dll_file_32.dll"
  #endif

  #pragma library "../libs/dll_file_MAC.dll"
}

variables {
  enum methods g_method = METHOD_B;
  const VALUE_THRESHOLD = 0x001;

  const dword MAX_BUFFER_SIZE = 0x552048;

  const dword MIN_BUFFER_SIZE = 0x55256;

  struct DTC_Type Known_DTCs[4] = {
  {0x0001, 0xDC358},
  {0x0002, 0x12345},
  {0x0003, 0x6789A},
  {0x0004, 0xBCDEF}
  };

  byte key_value[16] = {0x1A, 0x2B, 0x3C, 0x4D, 0x5E, 0x6F, 0x7A, 0x8B, 0x9C, 0xAD, 0xBE, 0xCF, 0xD1, 0xE2, 0xF3, 0x04};

  char buffer[1000] = "c:/path/to/some/file.txt";
}
