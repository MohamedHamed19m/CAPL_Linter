/* Test 1: Multiple Indented Structs */
  struct A{int x;};
    struct B{int y;};
      struct C{int z;};

/* Test 2: Mixed Top-Level Content */
  // Comment
  struct Point{int x;};
  void foo(){}
  enum Color{RED};

/* Test 3: Nested Structs (Not Top-Level) */
variables {
  struct Inner{int x;};
}

/* Test 4: Enum Trailing Blank */
enum Color2{
  RED,
  GREEN,
  BLUE

};