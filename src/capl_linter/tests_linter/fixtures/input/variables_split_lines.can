int gVar1;

variables
{
  int existingVar;
}

void main() {
}
