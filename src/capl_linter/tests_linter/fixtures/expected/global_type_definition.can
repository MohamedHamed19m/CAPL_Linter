

variables {
  int x;
  struct MyStruct {
    int a;
  };
  enum MyEnum {
    VAL1,
    VAL2
  };
}
