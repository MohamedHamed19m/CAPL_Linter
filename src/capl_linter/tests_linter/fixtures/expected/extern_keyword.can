variables {
  int x;
  char y[100];
}

on start {
  x = 1;
}
