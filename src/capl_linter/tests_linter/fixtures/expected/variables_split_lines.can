
variables {
  int existingVar;
  int gVar1;
}

void main() {
}
