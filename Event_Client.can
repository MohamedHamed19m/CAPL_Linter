// This CAPL file demonstrates how to set up an AUTOSAR Ethernet (SOME/IP) Event Server.
// It provides an event that clients can subscribe to and receive data from.
includes {

}

variables {
  dword serviceId = 10;
  dword instanceId = 1;
  dword eventId = 1;

  dword eventGroupId = 1;
}

on start {
  Initialize_Server();
}

void Initialize_Server() {
  dword aep;                            // Application Endpoint handle
  dword psi;                            // provided service handle

  dword peg;                            // provided Eventgroup handle
  dword pev;                            // provided Event handle
  IP_Endpoint ep;                       // IP Endpoint variable

  ep = IP_Endpoint(UDP:192.168.1.2:4001);

  // open Application Endpoint
  aep = AREthOpenLocalApplicationEndpoint(ep);

  // create Service Instance
  psi = AREthCreateProvidedServiceInstance(aep, serviceId, instanceId);

  // create Eventgroup
  peg = AREthAddProvidedEventGroup(psi, eventGroupId);

  // create Event and add Event to Eventgroup
  pev = AREthAddEvent(psi, eventId, "OnPrepareEvent1");
  AREthAddEventToEventgroup(peg, pev);

  // ensure that Event is sent cyclically
  AREthSetProperty(pev, "CycleTimeMs", 1000);

  // 1 = the first client will be already served by multicast.Further clients will also use
  // multicast.
  // This setting is only effective if there are multiple clients connected to the same Eventgroup.
  AREthSetProperty(eventGroupHandle, "MulticastThreshold", 1);

  // set multicast IP address for Eventgroup
  AREthSetProperty(eventGroupHandle, "SDMulticastIp", "239.192.255.251");

  // set VlanId for Eventgroup
  AREthSetProperty(eventGroupHandle, "SDVlanId", 2500);
}

void OnPrepareEvent1(dword eventHandle, dword messageHandle) {
  byte ret;
  byte Dummy_Data[8] = {0x01, 0x02, 0x03, 0x04, 0x05, 0x06, 0x07, 0x08};

  ret = AREthSetData(messageHandle, elcount(Dummy_Data), Dummy_Data); // form 2
  if (ret != 0) {
    write("Error setting Event data: %d", ret);
  }
}

void OnAREthSDServerEventGroupStatusChanged(dword serviceId, dword instanceId, dword eventGroupId, long status, dword newIpAddress, dword newPort) {
  char buffer[100];
  if (status == 0) {
    snprintf(buffer, elcount(buffer), "not subscribed");
  }
  else if (status == 1) {
    snprintf(buffer, elcount(buffer), "subscribed");
    @sysvar::MyNamespace::ServerEventGroupSubscribed = 1;
  }
  else {
    snprintf(buffer, elcount(buffer), "Undefined status");
  }
  write("Event group (ID %d), of service %d (instance %d): %s", eventGroupId, serviceId, instanceId, buffer);
}

variables {
  IP_Endpoint TCP:192.168.1.1:4000 ipEndpoint1;
  IP_Endpoint 192.168.1.2:4001 ipEndpoint2;
  IP_Endpoint 192.168.1.2 ipEndpoint3;
  IP_Endpoint UDP:[ff::1]:6000 ipEndpoint4;
  IP_Endpoint [ff::1]:6001 ipEndpoint5;
  IP_Endpoint ff::1 ipEndpoint6;
}

on start {
  IP_Endpoint ep;
  ep = IP_Endpoint(192.168.1.2:4001);
  //...do something with ep
}

on start {
  DoSomething(IP_Address(FC00::0001));
}

void DoSomething(IP_Address addr) {
  if (addr.IsIPv4Address()) {
    //...
  }
  else if (addr.IsIPv6Address()) {
    //...
  }
}

on start {
  IP_Endpoint 192.168.1.1:4000 ep1;
  IP_Endpoint 192.168.1.1:4000 ep2;
  if (ep1 == ep2) {
    write("Endpoints are equal!");
  }
}
