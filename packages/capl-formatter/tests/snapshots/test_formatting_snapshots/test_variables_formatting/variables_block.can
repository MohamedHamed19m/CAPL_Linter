
variables {
  int x;
  char y[10] = "test";
}
